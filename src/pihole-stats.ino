#include "env.h"
#include <ESP8266WiFi.h>
#include <ESP8266HTTPClient.h>
#include <ArduinoJson.h>
#include "TFT_22_ILI9225.h"
 
TFT_22_ILI9225 tft = TFT_22_ILI9225(D4, D3, D8, 0, 0);

uint16_t midX = 87;
uint16_t midY = 109;
String domainsBlocked;
String queriesToday;
String blockedToday;
String percentToday;
static const uint8_t PROGMEM logo[] = {
  0x0,0x0,0x0,0x0,0x0,0x0,0x0,
  0x0,0x1f,0x80,0x0,0x0,0x0,0x0,
  0x0,0x1f,0xe0,0x0,0x0,0x0,0x0,
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  0x0,0x0,0x0,0xf8,0x0,0x0,0x0
};
 
void setupWiFi() {
  tft.drawText(10, 10, "Connecting...");

  // Disable access point mode
  WiFi.mode(WIFI_STA);

  // Begin connecting to wifi
  if (WiFi.SSID() != WIFI_SSID) {
    WiFi.begin(WIFI_SSID, WIFI_PASS);
    WiFi.persistent(true);
    WiFi.setAutoConnect(true);
    WiFi.setAutoReconnect(true);
  }

  while (WiFi.status() != WL_CONNECTED) {
    tft.fillCircle(midX, midY, 20, COLOR_WHITE);
    delay(250);
    tft.fillCircle(midX, midY, 20, COLOR_BLACK);
    delay(250);
  }

  tft.clear();
}

void setupTft() {
  tft.begin();
  tft.clear();
  tft.setFont(Terminal12x16);
}

void setup() {
  setupTft();
  setupWiFi();
  setupLabels();
  delay(1000);
}

void setupLabels() {
  tft.setFont(Terminal6x8);
  tft.drawText(10, 10, "Queries today");
  tft.drawText(10, 48, "Blocked today");
  tft.drawText(10, 86, "Ad % today");
  tft.drawText(10, 124, "Blacklisted");
  tft.setFont(Terminal12x16);
  tft.drawBitmap(125, 162, logo, 50, 50, COLOR_RED);
}
 
void loop() {
  if (WiFi.status() == WL_CONNECTED) {
    HTTPClient http;
 
    http.begin("http://pi.hole/admin/api.php?summary");
    int httpCode = http.GET();                                                                  //Send the request
 
    if (httpCode > 0) {
      DynamicJsonBuffer jsonBuffer;
      JsonObject& payloadData = jsonBuffer.parseObject(http.getString());

      if (queriesToday != payloadData["dns_queries_today"]) {
        tft.drawText(10, 24, queriesToday, COLOR_BLACK);
        queriesToday = payloadData["dns_queries_today"].as<String>();
        tft.drawText(10, 24, payloadData["dns_queries_today"]);
      }

      if (blockedToday != payloadData["ads_blocked_today"]) {
        tft.drawText(10, 62, blockedToday, COLOR_BLACK);
        blockedToday = payloadData["ads_blocked_today"].as<String>();
        tft.drawText(10, 62, payloadData["ads_blocked_today"]);
      }

      if (percentToday != payloadData["ads_percentage_today"]) {
        tft.drawText(10, 100, percentToday, COLOR_BLACK);
        percentToday = payloadData["ads_percentage_today"].as<String>();
        tft.drawText(10, 100, payloadData["ads_percentage_today"]);
      }

      if (domainsBlocked != payloadData["domains_being_blocked"]) {
        tft.drawText(10, 138, domainsBlocked, COLOR_BLACK);
        domainsBlocked = payloadData["domains_being_blocked"].as<String>();
        tft.drawText(10, 138, payloadData["domains_being_blocked"]);
      }
    }
 
    http.end();
  }
 
  delay(1000);
}
